## yocto/meta-pck/conf/layer.conf
```bitbake
# We have a conf and classes directory, add to BBPATH
BBPATH .= ":${LAYERDIR}"

# We have recipes-* directories, add to BBFILES
BBFILES += "${LAYERDIR}/recipes-*/*/*.bb \
            ${LAYERDIR}/recipes-*/*/*.bbappend"

BBFILE_COLLECTIONS += "meta-pck"
BBFILE_PATTERN_meta-pck = "^${LAYERDIR}/"
BBFILE_PRIORITY_meta-pck = "6"

LAYERDEPENDS_meta-pck = "core"
LAYERSERIES_COMPAT_meta-pck = "scarthgap"
```
